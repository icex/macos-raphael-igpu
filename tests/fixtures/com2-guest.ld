ENTRY(_start)

SECTIONS
{
    . = 1M;
    .multiboot : { KEEP(*(.multiboot)) }
    .text : { *(.text.entry) *(.text*) }
    .rodata : { *(.rodata*) }
    .data : { *(.data*) }
    .bss : { *(.bss*) *(COMMON) }
    /DISCARD/ : { *(.comment) *(.note*) *(.eh_frame*) }
}
